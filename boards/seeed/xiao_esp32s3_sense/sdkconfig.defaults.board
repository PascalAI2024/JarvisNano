## boards/seeed/xiao_esp32s3_sense/sdkconfig.defaults.board
```kconfig
# Seeed XIAO ESP32-S3 Sense (ESP32-S3R8: 8 MB flash, 8 MB octal PSRAM)
CONFIG_IDF_TARGET="esp32s3"
CONFIG_ESP_DEFAULT_CPU_FREQ_MHZ_240=y

# 8 MB QIO flash @ 80 MHz (conservative; bump to 120 MHz once stable).
CONFIG_ESPTOOLPY_FLASHMODE_QIO=y
CONFIG_ESPTOOLPY_FLASHFREQ_80M=y
CONFIG_ESPTOOLPY_FLASHSIZE_8MB=y

# 8 MB octal PSRAM @ 80 MHz. (Was capped at 40 MHz earlier to stabilize
# the OV3660 camera path which is now disabled — see CAMERA section
# below — so we restore full PSRAM bandwidth. Empirically the HTTP
# server is bandwidth-bound on PSRAM at 40 MHz: serving the 66 KB
# gzipped dashboard takes 8+ s, so the browser appears to hang. At
# 80 MHz the same response lands sub-second.)
CONFIG_SPIRAM=y
CONFIG_SPIRAM_MODE_OCT=y
CONFIG_SPIRAM_SPEED_80M=y

# Audio: PDM in (on-board mic) + I2S std out (placeholder).
CONFIG_ESP_BOARD_PERIPH_I2S_SUPPORT=y
CONFIG_CODEC_DUMMY_SUPPORT=y

# Camera: STILL DISABLED tonight.
# 2026 production XIAO ESP32-S3 Sense units ship with the OV3660 (3MP)
# sensor at SCCB 0x3C — NOT the OV2640 (2MP) at 0x30 shown in older
# Seeed wiki diagrams. Identified by chip ID 0x3660 read from
# register 0x300A/0x300B.
#
# patches/0003-dvp-cam-scan-for-jpeg-soi.patch fixes ONE upstream bug
# (the NO-SOI frame rejection that flooded the log and starved the
# HTTP server). After applying it the JPEG path no longer spams
# NO-SOI — but a second cascading bug still breaks capture: the
# OV3660 SCCB writes during ov3660_set_format() fail mid-sequence
# (`s_sccb_i2c_transmit_reg_a16v8(88): failed to i2c transmit`) and
# the driver falls back to a YUYV mode that hangs on dequeue.
#
# Camera support stays off until we either:
#   1. Switch to the legacy `esp32-camera` driver (different code path,
#      Khangura's Feb-2026 write-up confirms it works on this hardware)
#   2. Find the upstream fix for the SCCB-mid-format-set failure
# Re-enable by flipping the next four lines back to y.
# CONFIG_ESP_BOARD_DEV_CAMERA_SUPPORT=n
# CONFIG_ESP_VIDEO_ENABLE_DVP_VIDEO_DEVICE=n
# CONFIG_CAMERA_OV3660=n
# CONFIG_CAMERA_OV3660_DVP_JPEG_1280X720_12FPS=n

# USB: native USB-C (CDC) for monitor/log over the same cable that powers it.
CONFIG_ESP_CONSOLE_USB_SERIAL_JTAG=y

CONFIG_LOG_MAXIMUM_LEVEL_DEBUG=y
CONFIG_LOG_DEFAULT_LEVEL_INFO=y
```
